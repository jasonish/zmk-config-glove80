## config/west.yml
```yaml
manifest:
  remotes:
    - name: moergo-sc
      url-base: https://github.com/moergo-sc
    - name: jasonish
      url-base: https://github.com/jasonish
  projects:
    - name: zmk
      import: app/west.yml

      # remote: moergo-sc
      # revision: main

      remote: jasonish
      revision: glove80-hold-trigger-on-release
  self:
    path: config
```
